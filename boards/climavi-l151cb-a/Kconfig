## boards/climavi-l151cb-a/Kconfig
```kconfig
# Copyright (c) 2020 Inria, 2022 Lukas Kamm
#
# This file is subject to the terms and conditions of the GNU Lesser
# General Public License v2.1. See the file LICENSE in the top level
# directory for more details.
#

config BOARD
    default "climavi-l151cb-a" if BOARD_CLIMAVI_L151CBA

config BOARD_CLIMAVI_L151CBA
    bool
    default y
    select CPU_MODEL_STM32L151CB

    # Put defined MCU peripherals here (in alphabetical order)
    select HAS_PERIPH_ADC
    select HAS_PERIPH_DAC
    select HAS_PERIPH_DMA
    select HAS_PERIPH_I2C
    select HAS_PERIPH_PWM
    select HAS_PERIPH_RTC
    select HAS_PERIPH_SPI
    select HAS_PERIPH_SPI_GPIO_MODE
    select HAS_PERIPH_TIMER
    select HAS_PERIPH_UART

    # Put other features for this board (in alphabetical order)
    select HAS_RIOTBOOT
```

## boards/powerbank-l010f4/Kconfig
```kconfig
# Copyright (c) 2020 Inria, 2022 Lukas Kamm
#
# This file is subject to the terms and conditions of the GNU Lesser
# General Public License v2.1. See the file LICENSE in the top level
# directory for more details.
#

config BOARD
    default "soil-l151c6-a" if BOARD_SOIL_L151C6A

config BOARD_SOIL_L151C6A
    bool
    default y
    select CPU_MODEL_STM32L151C6

    # Put defined MCU peripherals here (in alphabetical order)
    select HAS_PERIPH_ADC
    select HAS_PERIPH_DMA
    select HAS_PERIPH_I2C
    select HAS_PERIPH_PWM
    select HAS_PERIPH_RTC
    select HAS_PERIPH_SPI
    select HAS_PERIPH_SPI_GPIO_MODE
    select HAS_PERIPH_TIMER
    select HAS_PERIPH_UART

    # Put other features for this board (in alphabetical order)
    select HAS_RIOTBOOT
```

## drivers/fdc2x1x/Kconfig
```kconfig
# Copyright (c) 2022 Agvolution GmbH
#
# This file is subject to the terms and conditions of the GNU Lesser
# General Public License v2.1. See the file LICENSE in the top level
# directory for more details.

config MODULE_FDC2X1X
    bool "dox_grp_fdc"
    depends on TEST_KCONFIG
    depends on HAS_PERIPH_I2C
    select MODULE_PERIPH_I2C
    select MODULE_ZTIMER_MSEC
```
